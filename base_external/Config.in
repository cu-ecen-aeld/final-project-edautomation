## base_external/Config.in
```kconfig
source "$BR2_EXTERNAL_project_base_PATH/package/ldd/Config.in"
source "$BR2_EXTERNAL_project_base_PATH/package/final_project/Config.in"
```

## base_external/package/ldd/Config.in
```kconfig
config BR2_PACKAGE_LDD
	bool "ldd"
	help
	  Misc modules and scull components from the Linux Device Driver book, 3rd edition
```
